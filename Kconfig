## Kconfig
```kconfig
# Copyright (c) 2023 XiNGRZ
# SPDX-License-Identifier: MIT

config FOC
	bool "FOC for Zephyr"

if FOC

rsource "drivers/Kconfig"

endif # FOC
```

## drivers/sensor/Kconfig
```kconfig
# Copyright (c) 2023 XiNGRZ
# SPDX-License-Identifier: MIT

config AS5047
	bool "14-Bit On-Axis Magnetic Rotary Position Sensor with 11-Bit Decimal and Binary Incremental Pulse Count"
	depends on SPI
	select SENSOR

if AS5047

config AS5047_THREAD_PRIORITY
	int "Thread priority"
	default 10
	help
	  Priority of thread used by the driver to poll frames.

config AS5047_THREAD_STACK_SIZE
	int "Thread stack size"
	default 1024
	help
	  Stack size of thread used by the driver to poll frames.

endif # AS5047
```

## dts/bindings/sensor/ams,as5047.yaml
```yaml
# Copyright (c) 2023 XiNGRZ
# SPDX-License-Identifier: MIT

description: 14-Bit On-Axis Magnetic Rotary Position Sensor with 11-Bit Decimal and Binary Incremental Pulse Count

compatible: "ams,as5047"

include: spi-device.yaml

properties:
  label:
    type: string
    required: true

  cs-delay-us:
    type: int
    required: false
    default: 350
    description: Delay after pulling down and before releasing CS pin.

  init-delay-us:
    type: int
    required: false
    default: 0
    description: Delay before first poll.

  poll-interval-us:
    type: int
    required: false
    default: 10000
    description: Delay between each poll.

  precision-shift:
    type: int
    required: false
    default: 0
    description: The number of bits to shift the value read from the sensor to adjust its precision. The valid range is 0 to 14, inclusive.
```
